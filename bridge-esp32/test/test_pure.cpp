// Host test for the parts of the bridge that have no chip in them.
//
// The checksum and the watchdog are the two pieces that must agree with the
// Windows daemon to the least significant bit, and neither includes an Arduino,
// FreeRTOS or lwIP header. That is on purpose: it means they can be compiled and
// run on any machine, which is the only way to find out whether the bridge coasts
// correctly without unplugging a phone and watching a car.
//
// No test framework, so there is nothing to install:
//
//   g++ -std=c++17 -I src -o test_pure test/test_pure.cpp src/checksum.cpp src/watchdog.cpp
//   ./test_pure
//
// The expected numbers below are taken from tools/golden_vectors.json, which is
// generated by tools/golden_vectors.py and pins the C# and Swift suites too. They
// are written out as literals here so this file needs no JSON parser and no path
// back to the repository root.

#include <math.h>
#include <stdint.h>
#include <stdio.h>
#include <string.h>

#include "checksum.h"
#include "config.h"
#include "watchdog.h"
#include "wire_protocol.h"

using namespace osteer;

static int gFailures = 0;
static int gChecks = 0;

static void check(bool ok, const char* what) {
    gChecks++;
    if (!ok) {
        gFailures++;
        printf("FAIL  %s\n", what);
    }
}

static void checkEq(long long got, long long want, const char* what) {
    gChecks++;
    if (got != want) {
        gFailures++;
        printf("FAIL  %s: got %lld, want %lld\n", what, got, want);
    }
}

static void fromHex(const char* hex, uint8_t* out, size_t count) {
    size_t written = 0;
    for (const char* p = hex; *p && written < count; p++) {
        if (*p == ' ') {
            continue;
        }
        unsigned value = 0;
        sscanf(p, "%2x", &value);
        out[written++] = static_cast<uint8_t>(value);
        p++;
    }
}

// ------------------------------------------------------------------ checksum

static void testChecksum() {
    // The four published XXH32 reference vectors. This is the anchor for
    // everything else: agreeing with the daemon only means something if both
    // agree with a source outside the project.
    checkEq(xxh32(reinterpret_cast<const uint8_t*>(""), 0, 0), 0x02CC5D05,
            "XXH32 of empty input");
    checkEq(xxh32(reinterpret_cast<const uint8_t*>("a"), 1, 0), 0x550D7456,
            "XXH32 of \"a\"");
    checkEq(xxh32(reinterpret_cast<const uint8_t*>("abc"), 3, 0), 0x32D153FF,
            "XXH32 of \"abc\"");

    const char* spam = "Nobody inspects the spammish repetition";
    checkEq(xxh32(reinterpret_cast<const uint8_t*>(spam), strlen(spam), 0), 0xE2293B2F,
            "XXH32 of the long reference string");

    uint8_t kat0[28];
    memset(kat0, 0, sizeof(kat0));
    checkEq(xxh32_28(kat0), 0x38018272, "KAT-0");

    uint8_t kat1[28];
    fromHex("52 54 53 4f 01 00 39 30 ff ff 00 00 00 00 00 00 "
            "05 00 00 00 89 67 45 23 01 00 00 00", kat1, sizeof(kat1));
    checkEq(xxh32_28(kat1), 0xF4FDFD7A, "KAT-1");

    uint8_t kat2[28];
    fromHex("52 54 53 4f ff ff 00 80 00 00 ff ff 00 80 00 00 "
            "07 00 00 80 ff ff ff ff ff ff ff ff", kat2, sizeof(kat2));
    checkEq(xxh32_28(kat2), 0xA5B68410, "KAT-2");

    // The fixed-size path and the general one take different routes through the
    // same algorithm. If they diverge, the protocol quietly stops interoperating.
    checkEq(xxh32_28(kat1), xxh32(kat1, 28, kChecksumSeed), "fixed agrees with generic");

    // Every bit inside the covered range must change the answer.
    uint8_t frame[32];
    for (size_t i = 0; i < sizeof(frame); i++) {
        frame[i] = static_cast<uint8_t>(i * 7);
    }
    const uint32_t baseline = xxh32_28(frame);
    for (size_t byteIndex = 0; byteIndex < kChecksumCovered; byteIndex++) {
        for (int bit = 0; bit < 8; bit++) {
            uint8_t mutated[32];
            memcpy(mutated, frame, sizeof(frame));
            mutated[byteIndex] ^= static_cast<uint8_t>(1 << bit);
            check(xxh32_28(mutated) != baseline, "a covered bit did not change the checksum");
        }
    }

    // Bytes 28 to 31 carry the checksum itself and must not feed into it.
    uint8_t tail[32];
    memset(tail, 0, sizeof(tail));
    const uint32_t clean = xxh32_28(tail);
    memset(tail + kChecksumCovered, 0xFF, 4);
    checkEq(xxh32_28(tail), clean, "bytes past the covered range leaked in");
}

// ----------------------------------------------------------------- wire shape

static void testWireShape() {
    checkEq(static_cast<long long>(sizeof(UplinkPacket)), 32, "uplink size");
    checkEq(static_cast<long long>(sizeof(DownlinkPacket)), 16, "downlink size");
    checkEq(static_cast<long long>(offsetof(UplinkPacket, timestampNs)), 20, "timestamp offset");
    checkEq(static_cast<long long>(offsetof(UplinkPacket, checksum)), 28, "checksum offset");

    // Invariant I10: -32768 is the one 16-bit value with no positive twin.
    checkEq(saturateSteer(-32768), -32767, "steer saturation");
    checkEq(saturateSteer(-32767), -32767, "steer at the negative limit");
    checkEq(saturateSteer(32767), 32767, "steer at the positive limit");

    // Sequence numbers wrap. The table is the same one the daemon is tested on.
    checkEq(seqDelta(0, 65535), 1, "wrap 65535 to 0 is newer");
    checkEq(seqDelta(65535, 0), -1, "0 to 65535 is stale");
    checkEq(seqDelta(5, 5), 0, "a repeat is a duplicate");
    checkEq(seqDelta(32768, 0), -32768, "half the range away reads as stale");
    checkEq(seqDelta(32767, 0), 32767, "just under half reads as newer");
    checkEq(seqDelta(100, 90), 10, "ten dropped packets");
}

// ------------------------------------------------------------------ watchdog

static UplinkPacket makePacket(int16_t steer, uint16_t thr, uint16_t brk,
                               uint16_t clu, uint32_t buttons) {
    UplinkPacket p;
    memset(&p, 0, sizeof(p));
    p.magic = kUplinkMagic;
    p.steer = steer;
    p.throttle = thr;
    p.brake = brk;
    p.clutch = clu;
    p.buttons = buttons;
    return p;
}

static int64_t ms(double value) {
    return static_cast<int64_t>(value * 1000.0);
}

static void testDecayCurve() {
    struct Point {
        double silenceMs;
        int value;
    };
    // tools/golden_vectors.json, watchdog.decay_from_40000.
    const Point points[] = {
        {100, 40000}, {120, 20537}, {150, 7555}, {200, 1427},
        {240, 376},   {245, 318},   {249, 279},
    };

    for (const Point& point : points) {
        Watchdog wd;
        ControlState out{};
        wd.onPacket(0, makePacket(12000, 40000, 0, 0, 0));
        wd.evaluate(0, out);
        wd.evaluate(ms(point.silenceMs), out);

        checkEq(out.throttle, point.value, "decay value");
        // Steering is held, not decayed. Centring the wheel mid-corner is worse
        // than keeping the last known angle.
        checkEq(out.steer, 12000, "steering was not held during the decay");
        checkEq(out.buttons, 0, "a paddle stuck through the decay");
    }
}

static void testFailsafeCoasts() {
    Watchdog wd;
    ControlState out{};
    wd.onPacket(0, makePacket(-30000, 65535, 65535, 40000, 0xFFFFFFFF));
    wd.evaluate(0, out);
    wd.evaluate(ms(250), out);

    checkEq(static_cast<int>(wd.state()), static_cast<int>(WdState::FailSafe), "state at 250 ms");

    // A full brake injected while the link is down destabilises the tyre model and
    // can spin a car mid-corner; coasting is recoverable.
    checkEq(out.brake, 0, "FAIL-SAFE braked instead of coasting");
    checkEq(out.steer, 0, "steering not centred");
    checkEq(out.throttle, 0, "throttle not shut");
    checkEq(out.clutch, 0, "clutch not released");
    checkEq(out.buttons, 0, "buttons not cleared");
    check(wd.alertPending(), "no alert raised");
}

static void testDualSlew() {
    Watchdog wd;
    ControlState out{};

    // Into the fail-safe first, so both slews start from zero.
    wd.onPacket(0, makePacket(0, 0, 0, 0, 0));
    wd.evaluate(0, out);
    wd.evaluate(ms(300), out);
    checkEq(static_cast<int>(wd.state()), static_cast<int>(WdState::FailSafe), "reached FAIL-SAFE");

    const int64_t t0 = ms(300);
    wd.onPacket(t0, makePacket(32767, 65535, 0, 0, 0x5));
    wd.evaluate(t0, out);
    checkEq(static_cast<int>(wd.state()), static_cast<int>(WdState::Recovering), "entered RECOVERING");
    checkEq(out.steer, 0, "the first frame after recovery must start from zero");
    checkEq(out.throttle, 0, "the first frame after recovery must start from zero");

    // Buttons are never slewed. Half a gear change is not a thing.
    checkEq(out.buttons, 0x5, "buttons were slewed");

    struct Point {
        double elapsedMs;
        int value;
    };
    // watchdog.steer_slew_0_to_32767. The 297 ms value is 32439, not 32440:
    // 32767 * 297 / 300 is 32439.33, and an expected value one too high would
    // fail a correct implementation.
    const Point steerPoints[] = {
        {75, 8192}, {150, 16384}, {285, 31129}, {297, 32439}, {299, 32658}, {300, 32767},
    };
    for (const Point& point : steerPoints) {
        Watchdog w;
        ControlState o{};
        w.onPacket(0, makePacket(0, 0, 0, 0, 0));
        w.evaluate(0, o);
        w.evaluate(ms(300), o);
        w.onPacket(ms(300), makePacket(32767, 65535, 0, 0, 0));
        w.evaluate(ms(300), o);
        w.onPacket(ms(300 + point.elapsedMs), makePacket(32767, 65535, 0, 0, 0));
        w.evaluate(ms(300 + point.elapsedMs), o);
        checkEq(o.steer, point.value, "steer slew");
    }

    const Point pedalPoints[] = {
        {25, 16384}, {50, 32768}, {95, 62258}, {99, 64880}, {100, 65535},
    };
    for (const Point& point : pedalPoints) {
        Watchdog w;
        ControlState o{};
        w.onPacket(0, makePacket(0, 0, 0, 0, 0));
        w.evaluate(0, o);
        w.evaluate(ms(300), o);
        w.onPacket(ms(300), makePacket(32767, 65535, 0, 0, 0));
        w.evaluate(ms(300), o);
        w.onPacket(ms(300 + point.elapsedMs), makePacket(32767, 65535, 0, 0, 0));
        w.evaluate(ms(300 + point.elapsedMs), o);
        checkEq(o.throttle, point.value, "pedal slew");
    }
}

static void testShortHiccupSnaps() {
    // A brief silence should not cost a 300 ms slew if the wheel came back close
    // to where it was.
    Watchdog wd;
    ControlState out{};
    wd.onPacket(0, makePacket(12000, 30000, 0, 0, 0));
    wd.evaluate(0, out);
    wd.evaluate(ms(150), out);
    checkEq(static_cast<int>(wd.state()), static_cast<int>(WdState::Decaying), "entered DECAYING");

    wd.onPacket(ms(160), makePacket(13000, 30000, 0, 0, 0));
    wd.evaluate(ms(160), out);
    checkEq(static_cast<int>(wd.state()), static_cast<int>(WdState::Live), "a small change should snap");
    checkEq(out.steer, 13000, "snap did not take the new angle");

    // A large change does not snap: the wheel moved a long way while we could not
    // see it, and jumping there would yank the car.
    Watchdog wd2;
    ControlState out2{};
    wd2.onPacket(0, makePacket(0, 0, 0, 0, 0));
    wd2.evaluate(0, out2);
    wd2.evaluate(ms(150), out2);
    wd2.onPacket(ms(160), makePacket(32767, 0, 0, 0, 0));
    wd2.evaluate(ms(160), out2);
    checkEq(static_cast<int>(wd2.state()), static_cast<int>(WdState::Recovering),
            "a large change should slew, not snap");
}

static void testLinkDownSkipsTheDecay() {
    // The access point saying the station left is better evidence than silence.
    // Riding out 250 ms of timeout with the last steering angle still applied is
    // exactly what the fail-safe exists to prevent.
    Watchdog wd;
    ControlState out{};
    wd.onPacket(0, makePacket(-25000, 50000, 0, 0, 0));
    wd.evaluate(0, out);

    wd.onLinkDown(ms(10));
    wd.evaluate(ms(10), out);

    checkEq(static_cast<int>(wd.state()), static_cast<int>(WdState::FailSafe),
            "a reported disconnection should go straight to FAIL-SAFE");
    checkEq(out.steer, 0, "steering not centred");
    checkEq(out.brake, 0, "coast, never brake");
}

static void testIdleEmitsNothing() {
    Watchdog wd;
    ControlState out{};
    check(!wd.evaluate(ms(5000), out), "an idle watchdog wrote a report");
    checkEq(static_cast<int>(wd.state()), static_cast<int>(WdState::Idle), "idle state");
}

int main() {
    testChecksum();
    testWireShape();
    testDecayCurve();
    testFailsafeCoasts();
    testDualSlew();
    testShortHiccupSnaps();
    testLinkDownSkipsTheDecay();
    testIdleEmitsNothing();

    if (gFailures == 0) {
        printf("PASS  %d checks\n", gChecks);
        return 0;
    }
    printf("FAILED  %d of %d checks\n", gFailures, gChecks);
    return 1;
}
